#include <dt-bindings/zmk/input_transform.h>

&trackball_peripheral {
    cpi = <200>;
    x-invert;
	/delete-property/ y-invert;
};

&trackball_peripheral_split {
	input-processors
		= <&zip_xy_to_scroll_mapper>
		, <&zip_scroll_scaler 1 2>
		, <&zip_ble_report_rate_limit>;
};